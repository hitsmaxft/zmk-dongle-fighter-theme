## Kconfig
```kconfig
menuconfig ZMK_DONGLE_FIGHTER_THEME
    bool "KOF96 fighter animation provider assets"
    default y
    help
      Marks the ROM-derived KOF96 provider module as available. The consuming
      zmk-dongle-display build selects its profile and invokes the generator.
```

## config/west.yml
```yaml
manifest:
  projects:
    - name: zmk-dongle-display
      url: https://github.com/hitsmaxft/zmk-dongle-display
      revision: custom_anima
  self:
    path: zmk-dongle-fighter-theme
```
